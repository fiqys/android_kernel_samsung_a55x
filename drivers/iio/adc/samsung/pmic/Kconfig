## drivers/iio/adc/samsung/pmic/Kconfig
```kconfig
# SPDX-License-Identifier: GPL-2.0-only
#
# SAMSUNG PMIC ADC drivers
#
# When adding new entries keep the list in alphabetical order

config ADC_SAMSUNG_PMIC
	tristate "SAMSUNG PMIC  ADC driver support"
	depends on I2C
	help
	  Core support for the ADC block found in the Samsung PMIC series
	  for drivers such as the touchscreen and hwmon to use to share
	  this resource.

	  To compile this driver as a module, choose M here: the module will be
	  called exynos_adc.

config S2MPS25_ADC
	tristate "S2MPS25 ADC driver support"
	depends on MFD_S2MPS25
	help
	  Core support for the ADC block found in the Samsung PMIC series
	  for drivers such as the touchscreen and hwmon to use to share
	  this resource.

	  To compile this driver as a module, choose M here: the module will be
	  called exynos_adc.

config S2MPU15_ADC_8845
	tristate "S2MPU15 ADC driver support for 8845"
	depends on MFD_S2MPU15_8845
	help
	  Core support for the ADC block found in the Samsung PMIC series
	  for drivers such as the touchscreen and hwmon to use to share
	  this resource.

	  To compile this driver as a module, choose M here: the module will be
	  called exynos_adc.
```

## drivers/input/keyboard/samsung/pmic/Kconfig
```kconfig
# SPDX-License-Identifier: GPL-2.0-only
#
# Input core configuration
#

config KEYBOARD_SAMSUNG_PMIC
	depends on I2C
	tristate "Samsung Electronics PMIC Powerkey/Vol-down Controller"

config KEYBOARD_S2MPS25
	tristate "Samsung Electronics S2MPS25 Powerkey/Vol-down Controller"
	depends on I2C
	depends on MFD_S2MPS25

config KEYBOARD_S2MPS27
	tristate "Samsung Electronics S2MPS27 Powerkey/Vol-down Controller"
	depends on I2C
	depends on MFD_S2MPS27

config KEYBOARD_S2MPU15_8845
	tristate "Samsung Electronics S2MPU15 Powerkey/Vol-down Controller for s5e8845"
	depends on I2C
	depends on MFD_S2MPU15_8845
```

## drivers/rtc/samsung/pmic/Kconfig
```kconfig
# SPDX-License-Identifier: GPL-2.0-only
#
# PMIC RTC class/drivers configuration
#

config RTC_SAMSUNG_PMIC
	tristate "Samsung PMIC COMMON RTC"
	depends on I2C
	help
	  If you say yes here you will get support for the
	  RTC of Samsung PMIC series.
	  This driver can also be built as a module. If so, the module
	  will be called RTC_SAMSUNG_PMIC.

config RTC_DRV_S2MPS25
	tristate "Samsung PMIC S2MPS25 RTC"
	depends on MFD_S2MPS25
	help
	  If you say yes here you will get support for the
	  RTC of Samsung PMIC series.
	  This driver can also be built as a module. If so, the module
	  will be called rtc-s2mps25.

config RTC_DRV_S2MPU15_8845
	tristate "Samsung PMIC S2MPU15 RTC for 8845"
	depends on MFD_S2MPU15_8845
	help
	  If you say yes here you will get support for the
	  RTC of Samsung PMIC series.
	  This driver can also be built as a module. If so, the module
	  will be called rtc-s2mpu15.
```

## sound/soc/codecs/aw882xx/Kconfig
```kconfig
config SND_SMARTPA_AW882XX
        tristate "SoC Audio for awinic aw882xxseries"
        depends on I2C
        help
          this option enables support for aw882xxseries Smart PA.

config SND_AW_FEEDFORWARD
        bool "Awinic aw882xx series Feedforward Algorithm in external DSP"
        depends on SND_SMARTPA_AW882XX
```
